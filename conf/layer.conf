## conf/layer.conf
```bitbake
# We have a conf and classes directory, append to BBPATH
BBPATH .= ":${LAYERDIR}"

BBFILES += "${LAYERDIR}/recipes*/*/*.bb ${LAYERDIR}/recipes*/*/*.bbappend ${LAYERDIR}/images/*.bb"

BBFILE_COLLECTIONS += "meta-karedox"
BBFILE_PATTERN_meta-karedox := "^${LAYERDIR}/"
BBFILE_PRIORITY_meta-karedox = "16"

LAYERSERIES_COMPAT_meta-karedox = "scarthgap"
```

## conf/machine/karedox.conf
```bitbake
#@TYPE: Machine
#@NAME: Karedox 
#@DESCRIPTION: Machine configuration for the Karedox 

SOC_FAMILY = "rk3566"
TARGET_ARCH = "arm64"

DEFAULTTUNE ?= "cortexa55"

ROCKCHIP_CLOSED_TPL ?= "1"
  
require conf/machine/include/soc-family.inc
require conf/machine/include/rockchip-defaults.inc
require conf/machine/include/arm/armv8-2a/tune-cortexa55.inc
require conf/machine/include/rockchip-wic.inc

PREFERRED_PROVIDER_virtual/kernel = "linux-stable"
KERNEL_IMAGETYPE = "fitImage"

KBUILD_DEFCONFIG ?= "defconfig"
KERNEL_FEATURES:append:rk3566 = " bsp/rockchip/remove-non-rockchip-arch-arm64.scc"
KERNEL_CLASSES = "kernel-fitimage"
KERNEL_IMAGETYPE ?= "fitImage"

PREFERRED_PROVIDER_trusted-firmware-a = "rockchip-rkbin-tf-a"
PREFERRED_PROVIDER_optee-os = "rockchip-rkbin-optee-os"

UBOOT_SUFFIX ?= "itb"
UBOOT_ENTRYPOINT ?= "0x06000000"

TFA_PLATFORM = "rk3568"
TFA_BUILD_TARGET = "bl31"

ENABLE_STATELESS_VPU_GST ?= "1"
```
